## arch/arm/mach-meson6/Kconfig.boards
```kconfig
if ARCH_MESON6

config MACH_MESON6_SKT
	depends on ARCH_MESON6
	bool "Meson6 socket board"
	default y 
	help
          Support for Amlogic Meson6 socket board.

config MACH_MESON6_REF
	depends on ARCH_MESON6
	bool "Meson6 reference board"
	default y 
	help
          Support for Amlogic Meson6 reference development platform.

config MACH_MESON6_G18
	depends on ARCH_MESON6
	bool "Meson6 g18 board"
	help
          Support for Amlogic Meson6 g18 platform.


endif # ARCH_MESON6
```
